#include<reg51.h>
#include"ds18b20.h"
#include"delay.h"

#define uchar unsigned char
#define uint unsigned int

sbit DQ=P3^7;//ds18b20 端口
/******************************************************************/
/*                   DS18B20 初始化                               */
/******************************************************************/
void Init_DS18B20(void)
{
	uchar x=0;
	DQ = 1;    //拉高总线,等待
 	delayl(8);
 	DQ = 0;    //单片机将DQ拉低
 	delayl(80); //精确延时 大于 480us
 	DQ = 1;    //拉高总线,等待
 	delayl(10);
 	x=DQ;      //稍做延时后 如果x=0则初始化成功 x=1则初始化失败
 	delayl(5);
 }


/******************************************************************/
/*                    DS18B20读一个字节                           */
/******************************************************************/
uchar ReadOneChar(void)	// DS18B20读一个字节
{
	uchar i=0;
	uchar dat = 0;
	for (i=8;i>0;i--)
 	{
  		DQ = 0; // 给脉冲信号
  		dat>>=1;
  		DQ = 1; // 给脉冲信号，主机在读时隙期间必须释放总线
  		if(DQ)
   		dat|=0x80;
  		delayl(5);
 	}
 	return(dat);
}


/******************************************************************/
/*                 DS18B20写一个字节                              */
/******************************************************************/
void WriteOneChar(uchar dat) //DS18B20写一个字节
{
 	uchar i=0;
 	for (i=8; i>0; i--)
 	{
  		DQ = 0;
  		DQ = dat&0x01;//取最低位
  		delayl(5);
  		DQ = 1;
  		dat>>=1;//左移
 	}
	delayl(5);
}

/******************************************************************/
/*                   DS18B20读取温度                              */
/******************************************************************/
uint ReadTemperature(void) //DS18B20读取温度
{
	uchar a=0;
	uint b=0;
	uint t=0;
	Init_DS18B20();//DS18B20初始化
	WriteOneChar(0xCC); // 跳过读序号列号的操作
	WriteOneChar(0x44); // 启动温度转换
	delayl(200);       //延时以求信号的稳定
	Init_DS18B20();    //DS18B20再次初始化
	WriteOneChar(0xCC); //跳过读序号列号的操作 
	WriteOneChar(0xBE); //读取温度寄存器等（共可读9个寄存器） 前两个就是温度
	a=ReadOneChar();   //低位
	b=ReadOneChar();   //高位
	b<<=8;  //b左移8位
	t=a+b;  //把a与b结合，放在16位的t中   此处两行代码也可用t=(（b*256）+1)替代 原理相同
	return(t);
}